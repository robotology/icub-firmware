/*
 * Copyright (C) 2012 iCub Facility - Istituto Italiano di Tecnologia
 * Author:  Marco Accame
 * email:   marco.accame@iit.it
 * website: www.robotcub.org
 * Permission is granted to copy, distribute, and/or modify this program
 * under the terms of the GNU General Public License, version 2 or any
 * later version published by the Free Software Foundation.
 *
 * A copy of the license can be found at
 * http://www.robotcub.org/icub/license/gpl.txt
 *
 * This program is distributed in the hope that it will be useful, but
 * WITHOUT ANY WARRANTY; without even the implied warranty of
 * MERCHANTABILITY or FITNESS FOR A PARTICULAR PURPOSE. See the GNU General
 * Public License for more details
*/

/* @file       hal_extbrd_keil_mcbqvga.c
	@brief      This file implements internals of the temperature sensor module.
	@author     marco.accame@iit.it
    @date       10/24/2012
**/

// - modules to be built: contains the HAL_USE_* macros ---------------------------------------------------------------
#include "hal_brdcfg_modules.h"

#warning WIP --> fix extbrd_keil so thta it uses spi correctly

#ifdef  HAL_USE_EXTBRD_KEIL_MCBQVGA

// --------------------------------------------------------------------------------------------------------------------
// - external dependencies
// --------------------------------------------------------------------------------------------------------------------

#include "stdlib.h"
#include "string.h"
#include "hal_base_hid.h" 
#include "hal_brdcfg.h"


#include "stdio.h"

//#include "hal_stm32xx_include.h"



 
// --------------------------------------------------------------------------------------------------------------------
// - declaration of extern public interface
// --------------------------------------------------------------------------------------------------------------------

#include "hal_extbrd_keil_mcbqvga.h"



// --------------------------------------------------------------------------------------------------------------------
// - declaration of extern hidden interface 
// --------------------------------------------------------------------------------------------------------------------

#include "hal_extbrd_keil_mcbqvga_hid.h"


// --------------------------------------------------------------------------------------------------------------------
// - #define with internal scope
// --------------------------------------------------------------------------------------------------------------------

//#define HAL_EXTBRD_KEIL_MCBQVGA_SPI_USEACTIVITY_RAW08BIT
#define HAL_EXTBRD_KEIL_MCBQVGA_SPI_USEACTIVITY_SINGLEFRAME


#define HAL_EXTBRD_KEIL_MCBQVGA_SPI_START   (0x70)              
#define HAL_EXTBRD_KEIL_MCBQVGA_SPI_RD      (0x01)              
#define HAL_EXTBRD_KEIL_MCBQVGA_SPI_WR      (0x00)              
#define HAL_EXTBRD_KEIL_MCBQVGA_SPI_DATA    (0x02)             
#define HAL_EXTBRD_KEIL_MCBQVGA_SPI_INDEX   (0x00)             

#define HAL_EXTBRD_KEIL_MCBQVGA_WIDTH       320                 
#define HAL_EXTBRD_KEIL_MCBQVGA_HEIGHT      240                 


#define HAL_EXTBRD_KEIL_MCBQVGA_COLBLACK    0x0000
#define HAL_EXTBRD_KEIL_MCBQVGA_COLWHITE    0xffff


#define HAL_EXTBRD_KEIL_MCBQVGA_POSCOLBACK    0
#define HAL_EXTBRD_KEIL_MCBQVGA_POSCOLTEXT   1


// --------------------------------------------------------------------------------------------------------------------
// - definition (and initialisation) of extern variables, but better using _get(), _set() 
// --------------------------------------------------------------------------------------------------------------------

extern const hal_extbrd_keil_mcbqvga_cfg_t hal_extbrd_keil_mcbqvga_cfg_default  = 
{ 
    .mode       = hal_extbrd_keil_mcbqvga_mode_spi,      
    .spiport    = hal_spi_port3
};

// --------------------------------------------------------------------------------------------------------------------
// - typedef with internal scope
// --------------------------------------------------------------------------------------------------------------------

typedef struct
{
    hal_extbrd_keil_mcbqvga_cfg_t   cfg;
    int8_t                          font;
} hal_extbrd_keil_mcbqvga_info_t;

typedef struct
{
    uint8_t             w;
    uint8_t             h;
    uint8_t             s;
    const void*         data;
} hal_extbrd_keil_mcbqvga_fonts_t;

// --------------------------------------------------------------------------------------------------------------------
// - declaration of static functions
// --------------------------------------------------------------------------------------------------------------------

static void s_hal_extbrd_keil_mcbqvga_initted_set(void);
static hal_boolval_t s_hal_extbrd_keil_mcbqvga_initted_is(void);

static hal_result_t s_hal_extbrd_keil_mcbqvga_hw_init(const hal_extbrd_keil_mcbqvga_cfg_t *cfg, hal_extbrd_keil_mcbqvga_info_t* info);



static uint16_t s_hal_extbrd_keil_mcbqvga_reg_read(uint8_t regaddr);
static void s_hal_extbrd_keil_mcbqvga_cmd_write(uint8_t cmd);
static uint16_t s_hal_extbrd_keil_mcbqvga_dat_read(void);
static void s_hal_extbrd_keil_mcbqvga_dat_write(uint16_t value);
static void s_hal_extbrd_keil_mcbqvga_reg_write(uint8_t regaddr, uint16_t value);

static void s_hal_extbrd_keil_mcbqvga_windowmax(void);

static void s_hal_extbrd_keil_mcbqvga_dat_start(void);
static void s_hal_extbrd_keil_mcbqvga_dat_onlywrite(uint16_t value);
static void s_hal_extbrd_keil_mcbqvga_dat_stop(void);

static void s_hal_extbrd_keil_mcbqvga_draw_char(uint16_t x, uint16_t y, uint8_t *c);

#if     defined(HAL_EXTBRD_KEIL_MCBQVGA_SPI_USEACTIVITY_RAW08BIT)
static hal_result_t s_hal_extbrd_keil_mcbqvga_spi_write(hal_spi_port_t port, uint8_t byte, uint8_t* readbyte);
#elif   defined(HAL_EXTBRD_KEIL_MCBQVGA_SPI_USEACTIVITY_SINGLEFRAME)
static hal_result_t s_hal_extbrd_keil_mcbqvga_spi_write(hal_spi_port_t port, uint8_t byte, uint8_t* readbyte);
static void s_hal_extbrd_keil_mcbqvga_spiframe_receiv(void* p);
#endif

// --------------------------------------------------------------------------------------------------------------------
// - definition (and initialisation) of static variables
// --------------------------------------------------------------------------------------------------------------------

static hal_boolval_t s_hal_extbrd_keil_mcbqvga_initted[1] = { hal_false };
static hal_extbrd_keil_mcbqvga_info_t s_hal_extbrd_keil_mcbqvga_info[1] = { {.cfg = { .mode = hal_extbrd_keil_mcbqvga_mode_spi, .spiport = hal_spi_port3}, .font = 0 } };

static const hal_gpio_cfg_t gpio_cs = 
{
    .port = hal_gpio_portB, 
    .pin = hal_gpio_pin10, 
    .dir = hal_gpio_dirOUT, 
    .speed = hal_gpio_speed_high
};

static const hal_gpio_cfg_t gpio_STLD40D_enable = 
{
    .port = hal_gpio_portB, 
    .pin = hal_gpio_pin0, 
    .dir = hal_gpio_dirOUT, 
    .speed = hal_gpio_speed_high
};

static volatile uint16_t s_hal_extbrd_keil_mcbqvga_textcolors[2] = {HAL_EXTBRD_KEIL_MCBQVGA_COLWHITE, HAL_EXTBRD_KEIL_MCBQVGA_COLBLACK};


extern const uint16_t hal_extbrd_keil_mcbqvga_fonts_16x24[];
extern const uint8_t hal_extbrd_keil_mcbqvga_fonts_06x08[];

static hal_extbrd_keil_mcbqvga_fonts_t s_hal_extbrd_keil_mcbqvga_thefonts = 
{ 
    .w      = 6,
    .h      = 8,
    .s      = 1,
    .data   = hal_extbrd_keil_mcbqvga_fonts_06x08
};


// --------------------------------------------------------------------------------------------------------------------
// - definition of extern public functions
// --------------------------------------------------------------------------------------------------------------------


extern hal_result_t hal_extbrd_keil_mcbqvga_init(const hal_extbrd_keil_mcbqvga_cfg_t *cfg)
{
//    hal_result_t res = hal_res_NOK_generic; // dont remove ...
     
    if(NULL == cfg)
    {
        cfg  = &hal_extbrd_keil_mcbqvga_cfg_default;
    }
    
    if(hal_true == s_hal_extbrd_keil_mcbqvga_initted_is())
    {
        return(hal_res_OK);
    }    

    if(hal_res_OK != s_hal_extbrd_keil_mcbqvga_hw_init(cfg, &s_hal_extbrd_keil_mcbqvga_info[0]))
    {
        return(hal_res_NOK_generic);
    }
    
    hal_extbrd_keil_mcbqvga_settextproperties(hal_extbrd_keil_mcbqvga_fontsize_6x8, HAL_EXTBRD_KEIL_MCBQVGA_COLBLACK, HAL_EXTBRD_KEIL_MCBQVGA_COLWHITE);   
    
    s_hal_extbrd_keil_mcbqvga_initted_set();

    return(hal_res_OK);
}


extern hal_result_t hal_extbrd_keil_mcbqvga_clear(hal_extbrd_keil_mcbqvga_color_t color)
{
    hal_result_t res = hal_res_NOK_generic; 
    hal_spi_port_t spiport = s_hal_extbrd_keil_mcbqvga_info[0].cfg.spiport;

    
    if(hal_false == s_hal_extbrd_keil_mcbqvga_initted_is())
    {
        return(hal_res_NOK_generic);
    }
       
    // ok do what is required ...
    
    uint32_t i;
    
    s_hal_extbrd_keil_mcbqvga_windowmax();
    
    s_hal_extbrd_keil_mcbqvga_reg_write(0x20, 0);
    s_hal_extbrd_keil_mcbqvga_reg_write(0x21, 0);
    s_hal_extbrd_keil_mcbqvga_cmd_write(0x22);
    
    s_hal_extbrd_keil_mcbqvga_dat_start();
    for(i=0; i<(HAL_EXTBRD_KEIL_MCBQVGA_WIDTH*HAL_EXTBRD_KEIL_MCBQVGA_HEIGHT); i++)
    {
        s_hal_extbrd_keil_mcbqvga_dat_onlywrite(color);
    }   
    s_hal_extbrd_keil_mcbqvga_dat_stop();    
   
    return(hal_res_OK);
}

extern hal_result_t hal_extbrd_keil_mcbqvga_settextproperties(hal_extbrd_keil_mcbqvga_fontsize_t fontsize, hal_extbrd_keil_mcbqvga_color_t backcolor, hal_extbrd_keil_mcbqvga_color_t textcolor)
{
    hal_result_t res = hal_res_NOK_generic; 
    hal_spi_port_t spiport = s_hal_extbrd_keil_mcbqvga_info[0].cfg.spiport;

    
    if(hal_false == s_hal_extbrd_keil_mcbqvga_initted_is())
    {
        return(hal_res_NOK_generic);
    }
    
    // ok do what is required ...    
    s_hal_extbrd_keil_mcbqvga_textcolors[HAL_EXTBRD_KEIL_MCBQVGA_POSCOLBACK]  = backcolor;
    s_hal_extbrd_keil_mcbqvga_textcolors[HAL_EXTBRD_KEIL_MCBQVGA_POSCOLTEXT] = textcolor;
    

    if(hal_extbrd_keil_mcbqvga_fontsize_16x24 == fontsize)
    {
        s_hal_extbrd_keil_mcbqvga_info[0].font  = 0;
        s_hal_extbrd_keil_mcbqvga_thefonts.w    = 16;
        s_hal_extbrd_keil_mcbqvga_thefonts.h    = 24;
        s_hal_extbrd_keil_mcbqvga_thefonts.s    = 2;
        s_hal_extbrd_keil_mcbqvga_thefonts.data = hal_extbrd_keil_mcbqvga_fonts_16x24;
    }
    else if(hal_extbrd_keil_mcbqvga_fontsize_6x8 == fontsize)
    {
        s_hal_extbrd_keil_mcbqvga_info[0].font  = 1;
        s_hal_extbrd_keil_mcbqvga_thefonts.w    = 6;
        s_hal_extbrd_keil_mcbqvga_thefonts.h    = 8;
        s_hal_extbrd_keil_mcbqvga_thefonts.s    = 1;
        s_hal_extbrd_keil_mcbqvga_thefonts.data = hal_extbrd_keil_mcbqvga_fonts_06x08;
    }
       

    return(hal_res_OK);
}

extern hal_result_t hal_extbrd_keil_mcbqvga_clearline(uint16_t line)
{   
    if(hal_false == s_hal_extbrd_keil_mcbqvga_initted_is())
    {
        return(hal_res_NOK_generic);
    }
    
    // ok do what is required ...    
    s_hal_extbrd_keil_mcbqvga_windowmax();   
    hal_extbrd_keil_mcbqvga_putstring(line, 0, "                    ");
       
   
    return(hal_res_OK);
}

extern hal_result_t hal_extbrd_keil_mcbqvga_putstring(uint16_t line,  uint16_t column, char* str)
{
    if(hal_false == s_hal_extbrd_keil_mcbqvga_initted_is())
    {
        return(hal_res_NOK_generic);
    }
    
    // ok do what is required ...    
    s_hal_extbrd_keil_mcbqvga_windowmax();   
    
    while(*str) 
    {
        hal_extbrd_keil_mcbqvga_putchar(line, column++, *str++);
    } 
   
    return(hal_res_OK);
}

extern hal_result_t hal_extbrd_keil_mcbqvga_putchar(uint16_t line, uint16_t column, char chr)
{
    if(hal_false == s_hal_extbrd_keil_mcbqvga_initted_is())
    {
        return(hal_res_NOK_generic);
    }
    
    // ok do what is required ...    
    
    chr -= 32;
    
    uint8_t* data = (uint8_t*) s_hal_extbrd_keil_mcbqvga_thefonts.data;
    data = &data[s_hal_extbrd_keil_mcbqvga_thefonts.s * chr * s_hal_extbrd_keil_mcbqvga_thefonts.h];


    //s_hal_extbrd_keil_mcbqvga_draw_char(column * s_hal_extbrd_keil_mcbqvga_thefonts.w, line * s_hal_extbrd_keil_mcbqvga_thefonts.h, (uint8_t*)&s_hal_extbrd_keil_mcbqvga_thefonts.data[chr * s_hal_extbrd_keil_mcbqvga_thefonts.h]);
    s_hal_extbrd_keil_mcbqvga_draw_char(column * s_hal_extbrd_keil_mcbqvga_thefonts.w, line * s_hal_extbrd_keil_mcbqvga_thefonts.h, data);
  
    return(hal_res_OK);
}


// --------------------------------------------------------------------------------------------------------------------
// - definition of extern hidden functions 
// --------------------------------------------------------------------------------------------------------------------

// ---- isr of the module: begin ----
// empty-section
// ---- isr of the module: end ------


extern uint32_t hal_extbrd_keil_mcbqvga_hid_getsize(const hal_cfg_t *cfg)
{
    // no memory needed
    return(0);
}

extern hal_result_t hal_extbrd_keil_mcbqvga_hid_setmem(const hal_cfg_t *cfg, uint32_t *memory)
{
    // no memory needed
//    if(NULL == memory)
//    {
//        hal_base_hid_on_fatalerror(hal_fatalerror_missingmemory, "hal_xxx_hid_setmem(): memory missing");
//        return(hal_res_NOK_generic);
//    }


    memset(s_hal_extbrd_keil_mcbqvga_initted, hal_false, sizeof(s_hal_extbrd_keil_mcbqvga_initted));
    return(hal_res_OK);  
}

// --------------------------------------------------------------------------------------------------------------------
// - definition of static functions 
// --------------------------------------------------------------------------------------------------------------------


static void s_hal_extbrd_keil_mcbqvga_initted_set(void)
{
    s_hal_extbrd_keil_mcbqvga_initted[0] = hal_true;
}

static hal_boolval_t s_hal_extbrd_keil_mcbqvga_initted_is(void)
{
    return(s_hal_extbrd_keil_mcbqvga_initted[0]);
}

 
    
static hal_result_t s_hal_extbrd_keil_mcbqvga_hw_init(const hal_extbrd_keil_mcbqvga_cfg_t *cfg, hal_extbrd_keil_mcbqvga_info_t* info)
{
    hal_result_t res = hal_res_NOK_generic;   
    uint8_t data;
    hal_spi_port_t spiport = cfg->spiport;

#if     defined(HAL_EXTBRD_KEIL_MCBQVGA_SPI_USEACTIVITY_RAW08BIT)    
    static const hal_spi_cfg_t spicfg =
    {
        .ownership              = hal_spi_ownership_master,
        .dir                    = hal_spi_dir_txonly,
        .activity               = hal_spi_act_raw08bits,
        .speed                  = hal_spi_speed_18mbps,
        .sizeoftxframe          = 0,
        .sizeofrxframe          = 0,
        .onframetransm          = NULL,
        .onframereceiv          = NULL,
        .sizeoftxfifoofframes   = 0,
        .sizeofrxfifoofframes   = 0    
    };
#elif   defined(HAL_EXTBRD_KEIL_MCBQVGA_SPI_USEACTIVITY_SINGLEFRAME)
    static const hal_spi_cfg_t spicfg =
    {
        .ownership              = hal_spi_ownership_master,
        .dir                    = hal_spi_dir_txonly,
        .activity               = hal_spi_act_singleframe,
        .speed                  = hal_spi_speed_18mbps,
        .sizeoftxframe          = 1,
        .sizeofrxframe          = 1,
        .onframetransm          = NULL,
        .onframereceiv          = s_hal_extbrd_keil_mcbqvga_spiframe_receiv,
        .sizeoftxfifoofframes   = 4,
        .sizeofrxfifoofframes   = 4    
    };
#endif    
 
    // init spi    
    if(hal_res_OK != (res = hal_spi_init(spiport, &spicfg)))
    {
        return(res);
    }
    
    // put cs high   
    hal_gpio_configure(gpio_cs, NULL);
    hal_gpio_setval(gpio_cs.port, gpio_cs.pin, hal_gpio_valHIGH);
    
    hal_gpio_configure(gpio_STLD40D_enable, NULL);
    hal_gpio_setval(gpio_STLD40D_enable.port, gpio_STLD40D_enable.pin, hal_gpio_valHIGH);
    
    hal_sys_delay(50*1000);
    
    
    // config now ...
    
    uint16_t driverCode = s_hal_extbrd_keil_mcbqvga_reg_read(0x00);
    
    // following code is taken from keil's driver 
    
    /* Start Initial Sequence --------------------------------------------------*/
    s_hal_extbrd_keil_mcbqvga_reg_write(0x01, 0x0100);                 /* Set SS bit                         */
    s_hal_extbrd_keil_mcbqvga_reg_write(0x02, 0x0700);                 /* Set 1 line inversion               */
    s_hal_extbrd_keil_mcbqvga_reg_write(0x04, 0x0000);                 /* Resize register                    */
    s_hal_extbrd_keil_mcbqvga_reg_write(0x08, 0x0207);                 /* 2 lines front, 7 back porch        */
    s_hal_extbrd_keil_mcbqvga_reg_write(0x09, 0x0000);                 /* Set non-disp area refresh cyc ISC  */
    s_hal_extbrd_keil_mcbqvga_reg_write(0x0A, 0x0000);                 /* FMARK function                     */
    s_hal_extbrd_keil_mcbqvga_reg_write(0x0C, 0x0000);                 /* RGB interface setting              */
    s_hal_extbrd_keil_mcbqvga_reg_write(0x0D, 0x0000);                 /* Frame marker Position              */
    s_hal_extbrd_keil_mcbqvga_reg_write(0x0F, 0x0000);                 /* RGB interface polarity             */

    /* Power On sequence -------------------------------------------------------*/
    s_hal_extbrd_keil_mcbqvga_reg_write(0x10, 0x0000);                 /* Reset Power Control 1              */
    s_hal_extbrd_keil_mcbqvga_reg_write(0x11, 0x0000);                 /* Reset Power Control 2              */
    s_hal_extbrd_keil_mcbqvga_reg_write(0x12, 0x0000);                 /* Reset Power Control 3              */
    s_hal_extbrd_keil_mcbqvga_reg_write(0x13, 0x0000);                 /* Reset Power Control 4              */
    hal_sys_delay(200*1000);                            /* Discharge cap power voltage (200ms)*/
    s_hal_extbrd_keil_mcbqvga_reg_write(0x10, 0x12B0);                 /* SAP, BT[3:0], AP, DSTB, SLP, STB   */
    s_hal_extbrd_keil_mcbqvga_reg_write(0x11, 0x0007);                 /* DC1[2:0], DC0[2:0], VC[2:0]        */
    hal_sys_delay(50*1000);                             /* Delay 50 ms                        */
    s_hal_extbrd_keil_mcbqvga_reg_write(0x12, 0x01BD);                 /* VREG1OUT voltage                   */
    hal_sys_delay(50*1000);                             /* Delay 50 ms                        */
    s_hal_extbrd_keil_mcbqvga_reg_write(0x13, 0x1400);                 /* VDV[4:0] for VCOM amplitude        */
    s_hal_extbrd_keil_mcbqvga_reg_write(0x29, 0x000E);                 /* VCM[4:0] for VCOMH                 */
    hal_sys_delay(50*1000);                             /* Delay 50 ms                        */
    s_hal_extbrd_keil_mcbqvga_reg_write(0x20, 0x0000);                 /* GRAM horizontal Address            */
    s_hal_extbrd_keil_mcbqvga_reg_write(0x21, 0x0000);                 /* GRAM Vertical Address              */

    
    /* Adjust the Gamma Curve --------------------------------------------------*/
    if(driverCode == 0x5408) 
    {           /* LCD with touch                     */
        s_hal_extbrd_keil_mcbqvga_reg_write(0x30, 0x0B0D);
        s_hal_extbrd_keil_mcbqvga_reg_write(0x31, 0x1923);
        s_hal_extbrd_keil_mcbqvga_reg_write(0x32, 0x1C26);
        s_hal_extbrd_keil_mcbqvga_reg_write(0x33, 0x261C);
        s_hal_extbrd_keil_mcbqvga_reg_write(0x34, 0x2419);
        s_hal_extbrd_keil_mcbqvga_reg_write(0x35, 0x0D0B);
        s_hal_extbrd_keil_mcbqvga_reg_write(0x36, 0x1006);
        s_hal_extbrd_keil_mcbqvga_reg_write(0x37, 0x0610);
        s_hal_extbrd_keil_mcbqvga_reg_write(0x38, 0x0706);
        s_hal_extbrd_keil_mcbqvga_reg_write(0x39, 0x0304);
        s_hal_extbrd_keil_mcbqvga_reg_write(0x3A, 0x0E05);
        s_hal_extbrd_keil_mcbqvga_reg_write(0x3B, 0x0E01);
        s_hal_extbrd_keil_mcbqvga_reg_write(0x3C, 0x010E);
        s_hal_extbrd_keil_mcbqvga_reg_write(0x3D, 0x050E);
        s_hal_extbrd_keil_mcbqvga_reg_write(0x3E, 0x0403);
        s_hal_extbrd_keil_mcbqvga_reg_write(0x3F, 0x0607);
    }
    if(driverCode == 0xC990) 
    {           /* LCD without touch                  */
        s_hal_extbrd_keil_mcbqvga_reg_write(0x30, 0x0006);
        s_hal_extbrd_keil_mcbqvga_reg_write(0x31, 0x0101);
        s_hal_extbrd_keil_mcbqvga_reg_write(0x32, 0x0003);
        s_hal_extbrd_keil_mcbqvga_reg_write(0x35, 0x0106);
        s_hal_extbrd_keil_mcbqvga_reg_write(0x36, 0x0B02);
        s_hal_extbrd_keil_mcbqvga_reg_write(0x37, 0x0302);
        s_hal_extbrd_keil_mcbqvga_reg_write(0x38, 0x0707);
        s_hal_extbrd_keil_mcbqvga_reg_write(0x39, 0x0007);
        s_hal_extbrd_keil_mcbqvga_reg_write(0x3C, 0x0600);
        s_hal_extbrd_keil_mcbqvga_reg_write(0x3D, 0x020B);
    }

    /* Set GRAM area -----------------------------------------------------------*/
    s_hal_extbrd_keil_mcbqvga_reg_write(0x50, 0x0000);                 /* Horizontal GRAM Start Address      */
    s_hal_extbrd_keil_mcbqvga_reg_write(0x51, (HAL_EXTBRD_KEIL_MCBQVGA_HEIGHT-1));             /* Horizontal GRAM End   Address      */
    s_hal_extbrd_keil_mcbqvga_reg_write(0x52, 0x0000);                 /* Vertical   GRAM Start Address      */
    s_hal_extbrd_keil_mcbqvga_reg_write(0x53, (HAL_EXTBRD_KEIL_MCBQVGA_WIDTH-1));              /* Vertical   GRAM End   Address      */
    s_hal_extbrd_keil_mcbqvga_reg_write(0x60, 0xA700);                 /* Gate Scan Line                     */
    if(driverCode == 0x5408)             
    {   /* LCD with touch                     */
        s_hal_extbrd_keil_mcbqvga_reg_write(0x60, 0xA700);               /* Gate Scan Line                     */
    }
    if(driverCode == 0xC990) 
    {    /* LCD without touch                  */
        s_hal_extbrd_keil_mcbqvga_reg_write(0x60, 0x2700);               /* Gate Scan Line                     */
    }
    s_hal_extbrd_keil_mcbqvga_reg_write(0x61, 0x0001);                 /* NDL,VLE, REV                       */
    s_hal_extbrd_keil_mcbqvga_reg_write(0x6A, 0x0000);                 /* Set scrolling line                 */

    /* Partial Display Control -------------------------------------------------*/
    s_hal_extbrd_keil_mcbqvga_reg_write(0x80, 0x0000);
    s_hal_extbrd_keil_mcbqvga_reg_write(0x81, 0x0000);
    s_hal_extbrd_keil_mcbqvga_reg_write(0x82, 0x0000);
    s_hal_extbrd_keil_mcbqvga_reg_write(0x83, 0x0000);
    s_hal_extbrd_keil_mcbqvga_reg_write(0x84, 0x0000);
    s_hal_extbrd_keil_mcbqvga_reg_write(0x85, 0x0000);

    /* Panel Control -----------------------------------------------------------*/
    s_hal_extbrd_keil_mcbqvga_reg_write(0x90, 0x0010);
    s_hal_extbrd_keil_mcbqvga_reg_write(0x92, 0x0000);
    s_hal_extbrd_keil_mcbqvga_reg_write(0x93, 0x0003);
    s_hal_extbrd_keil_mcbqvga_reg_write(0x95, 0x0110);
    s_hal_extbrd_keil_mcbqvga_reg_write(0x97, 0x0000);
    s_hal_extbrd_keil_mcbqvga_reg_write(0x98, 0x0000);

    /* Set GRAM write direction
       I/D=10 (Horizontal : increment, Vertical : increment)
       AM=1   (address is updated in vertical writing direction)                */
    s_hal_extbrd_keil_mcbqvga_reg_write(0x03, 0x1038);

    s_hal_extbrd_keil_mcbqvga_reg_write(0x07, 0x0137);                 /* 262K color and display ON    */      
    
    
    
    memcpy(&info->cfg, cfg, sizeof(hal_extbrd_keil_mcbqvga_cfg_t));
    
    // store the i2caddress and the register address.
    return(hal_res_OK);
}

static uint16_t s_hal_extbrd_keil_mcbqvga_reg_read(uint8_t regaddr)
{
    s_hal_extbrd_keil_mcbqvga_cmd_write(regaddr);
    return(s_hal_extbrd_keil_mcbqvga_dat_read());
}

static void s_hal_extbrd_keil_mcbqvga_reg_write(uint8_t regaddr, uint16_t value)
{
    s_hal_extbrd_keil_mcbqvga_cmd_write(regaddr);
    s_hal_extbrd_keil_mcbqvga_dat_write(value);
}

static void s_hal_extbrd_keil_mcbqvga_cmd_write(uint8_t cmd)
{
    hal_spi_port_t spiport = s_hal_extbrd_keil_mcbqvga_info[0].cfg.spiport;
    
    hal_gpio_quickest_setval(gpio_cs.port, gpio_cs.pin, hal_gpio_valLOW);
  
  
    s_hal_extbrd_keil_mcbqvga_spi_write(spiport, HAL_EXTBRD_KEIL_MCBQVGA_SPI_START | HAL_EXTBRD_KEIL_MCBQVGA_SPI_WR | HAL_EXTBRD_KEIL_MCBQVGA_SPI_INDEX, NULL);
    s_hal_extbrd_keil_mcbqvga_spi_write(spiport, 0, NULL);
    s_hal_extbrd_keil_mcbqvga_spi_write(spiport, cmd, NULL);
    
    
    hal_gpio_quickest_setval(gpio_cs.port, gpio_cs.pin, hal_gpio_valHIGH);
}

static uint16_t s_hal_extbrd_keil_mcbqvga_dat_read(void)
{
    uint16_t value = 0;
    uint8_t vv0 = 0;
    uint8_t vv1 = 0;
 
    hal_spi_port_t spiport = s_hal_extbrd_keil_mcbqvga_info[0].cfg.spiport;
    
    hal_gpio_quickest_setval(gpio_cs.port, gpio_cs.pin, hal_gpio_valLOW);
 
 
    s_hal_extbrd_keil_mcbqvga_spi_write(spiport, HAL_EXTBRD_KEIL_MCBQVGA_SPI_START | HAL_EXTBRD_KEIL_MCBQVGA_SPI_RD | HAL_EXTBRD_KEIL_MCBQVGA_SPI_DATA, NULL);
    s_hal_extbrd_keil_mcbqvga_spi_write(spiport, 0, NULL);
    s_hal_extbrd_keil_mcbqvga_spi_write(spiport, 0, &vv1);
    value = vv1 << 8;
    s_hal_extbrd_keil_mcbqvga_spi_write(spiport, 0, &vv0);
    value |= vv0;
    
    
    
    
    hal_gpio_quickest_setval(gpio_cs.port, gpio_cs.pin, hal_gpio_valHIGH);
    
    return(value);
}

static void s_hal_extbrd_keil_mcbqvga_dat_write(uint16_t value)
{
    hal_spi_port_t spiport = s_hal_extbrd_keil_mcbqvga_info[0].cfg.spiport;
    
    hal_gpio_quickest_setval(gpio_cs.port, gpio_cs.pin, hal_gpio_valLOW);
 
 
    s_hal_extbrd_keil_mcbqvga_spi_write(spiport, HAL_EXTBRD_KEIL_MCBQVGA_SPI_START | HAL_EXTBRD_KEIL_MCBQVGA_SPI_WR | HAL_EXTBRD_KEIL_MCBQVGA_SPI_DATA, NULL);
    s_hal_extbrd_keil_mcbqvga_spi_write(spiport, value >> 8, NULL);
    s_hal_extbrd_keil_mcbqvga_spi_write(spiport, value & 0xff, NULL);
    
    hal_gpio_quickest_setval(gpio_cs.port, gpio_cs.pin, hal_gpio_valHIGH);
}

static void s_hal_extbrd_keil_mcbqvga_windowmax(void) 
{
    s_hal_extbrd_keil_mcbqvga_reg_write(0x50, 0);                      /* Horizontal GRAM Start Address      */
    s_hal_extbrd_keil_mcbqvga_reg_write(0x51, HAL_EXTBRD_KEIL_MCBQVGA_HEIGHT-1);               /* Horizontal GRAM End   Address (-1) */
    s_hal_extbrd_keil_mcbqvga_reg_write(0x52, 0);                      /* Vertical   GRAM Start Address      */
    s_hal_extbrd_keil_mcbqvga_reg_write(0x53, HAL_EXTBRD_KEIL_MCBQVGA_WIDTH-1);                /* Vertical   GRAM End   Address (-1) */
}


static void s_hal_extbrd_keil_mcbqvga_dat_start(void)
{
    hal_spi_port_t spiport = s_hal_extbrd_keil_mcbqvga_info[0].cfg.spiport;
    
    hal_gpio_quickest_setval(gpio_cs.port, gpio_cs.pin, hal_gpio_valLOW);
    
    s_hal_extbrd_keil_mcbqvga_spi_write(spiport, HAL_EXTBRD_KEIL_MCBQVGA_SPI_START | HAL_EXTBRD_KEIL_MCBQVGA_SPI_WR | HAL_EXTBRD_KEIL_MCBQVGA_SPI_DATA, NULL);   
}

static void s_hal_extbrd_keil_mcbqvga_dat_onlywrite(uint16_t value)
{
    hal_spi_port_t spiport = s_hal_extbrd_keil_mcbqvga_info[0].cfg.spiport;

    s_hal_extbrd_keil_mcbqvga_spi_write(spiport, value >> 8, NULL);
    s_hal_extbrd_keil_mcbqvga_spi_write(spiport, value & 0xff, NULL);
}


static void s_hal_extbrd_keil_mcbqvga_dat_stop(void)
{
    hal_gpio_quickest_setval(gpio_cs.port, gpio_cs.pin, hal_gpio_valHIGH);
}



static void s_hal_extbrd_keil_mcbqvga_draw_char(uint16_t x, uint16_t y, uint8_t *c)
{
    int idx = 0, i, j;

    uint8_t* c08 = (uint8_t*) c;
    uint16_t pixs;
    
    x = HAL_EXTBRD_KEIL_MCBQVGA_WIDTH-x-s_hal_extbrd_keil_mcbqvga_thefonts.w;
    s_hal_extbrd_keil_mcbqvga_reg_write(0x50, y);                      /* Horizontal GRAM Start Address      */
    s_hal_extbrd_keil_mcbqvga_reg_write(0x51, y+s_hal_extbrd_keil_mcbqvga_thefonts.h-1);             /* Horizontal GRAM End   Address (-1) */
    s_hal_extbrd_keil_mcbqvga_reg_write(0x52, x);                      /* Vertical   GRAM Start Address      */
    s_hal_extbrd_keil_mcbqvga_reg_write(0x53, x+s_hal_extbrd_keil_mcbqvga_thefonts.w-1);             /* Vertical   GRAM End   Address (-1) */

    s_hal_extbrd_keil_mcbqvga_reg_write(0x20, y);
    s_hal_extbrd_keil_mcbqvga_reg_write(0x21, x);
    
    s_hal_extbrd_keil_mcbqvga_cmd_write(0x22);    
    s_hal_extbrd_keil_mcbqvga_dat_start();
#if 0    
    for(j = 0; j < s_hal_extbrd_keil_mcbqvga_thefonts.h; j++) 
    {
        for (i = s_hal_extbrd_keil_mcbqvga_thefonts.w-1; i >= 0; i--) 
        {
            if((c[idx] & (1 << i)) == 0x00) 
            {
                s_hal_extbrd_keil_mcbqvga_dat_onlywrite(s_hal_extbrd_keil_mcbqvga_textcolors[HAL_EXTBRD_KEIL_MCBQVGA_POSCOLBACK]);
            } 
            else 
            {
                s_hal_extbrd_keil_mcbqvga_dat_onlywrite(s_hal_extbrd_keil_mcbqvga_textcolors[HAL_EXTBRD_KEIL_MCBQVGA_POSCOLTEXT]);
            }
        }
        c++;
    }
#else  
    
    if(1 == s_hal_extbrd_keil_mcbqvga_thefonts.s)
    {
        for (j = 0; j < s_hal_extbrd_keil_mcbqvga_thefonts.h; j++) {
          pixs = *(uint8_t *)c08;
          c08 += 1;
          
          //for (i = 0; i < s_hal_extbrd_keil_mcbqvga_thefonts.w; i++) {
            for (i = s_hal_extbrd_keil_mcbqvga_thefonts.w-1; i >= 0; i--) {
            s_hal_extbrd_keil_mcbqvga_dat_onlywrite (s_hal_extbrd_keil_mcbqvga_textcolors[(pixs >> i) & 1]);
          }
        } 
    }    
    else if(2 == s_hal_extbrd_keil_mcbqvga_thefonts.s)
    {
        for (j = 0; j < s_hal_extbrd_keil_mcbqvga_thefonts.h; j++) {
          pixs = *(uint16_t *)c08;
          c08 += 2;
          
          //for (i = 0; i < s_hal_extbrd_keil_mcbqvga_thefonts.w; i++) {
            for (i = s_hal_extbrd_keil_mcbqvga_thefonts.w-1; i >= 0; i--) {
            s_hal_extbrd_keil_mcbqvga_dat_onlywrite (s_hal_extbrd_keil_mcbqvga_textcolors[(pixs >> i) & 1]);
          }
        }
    }
#endif    
    s_hal_extbrd_keil_mcbqvga_dat_stop();

}



#if     defined(HAL_EXTBRD_KEIL_MCBQVGA_SPI_USEACTIVITY_RAW08BIT)
static hal_result_t s_hal_extbrd_keil_mcbqvga_spi_write(hal_spi_port_t port, uint8_t byte, uint8_t* readbyte)
{
    return(hal_spi_write(port, byte, readbyte)); 
}
#elif   defined(HAL_EXTBRD_KEIL_MCBQVGA_SPI_USEACTIVITY_SINGLEFRAME)

static volatile uint8_t anewframehasarrived = 0;


static hal_result_t s_hal_extbrd_keil_mcbqvga_spi_write(hal_spi_port_t port, uint8_t byte, uint8_t* readbyte)
{
    uint8_t rxbyte = 255;
    uint8_t sizeofframe = 0;
    
    if(NULL == readbyte)
    {
        hal_spi_direction_set(port, hal_spi_dir_txonly);
        hal_spi_put(port, &byte, 1, hal_true); 
    }
    else
    {
        hal_spi_direction_set(port, hal_spi_dir_txrx);    
        hal_spi_put(port, &byte, 1, hal_true); 
        
        for(;;)
        {
            if(1 == anewframehasarrived)
            {
                anewframehasarrived = 0;
                break;
            }
        }

        hal_spi_get(port, &rxbyte, &sizeofframe, NULL);        
        *readbyte = rxbyte;
    }
    
    return(hal_res_OK);       
}


static void s_hal_extbrd_keil_mcbqvga_spiframe_receiv(void* p)
{
    anewframehasarrived = 1;
}
#endif


// -- static variables

// fonts are taken from keil

const unsigned short hal_extbrd_keil_mcbqvga_fonts_16x24[] = {
  /* 0x20: Space ' ' */
  0x0000, 0x0000, 0x0000, 0x0000, 0x0000, 0x0000, 0x0000, 0x0000,
  0x0000, 0x0000, 0x0000, 0x0000, 0x0000, 0x0000, 0x0000, 0x0000,
  0x0000, 0x0000, 0x0000, 0x0000, 0x0000, 0x0000, 0x0000, 0x0000,
  /* 0x21: '!' */
  0x0000, 0x0180, 0x0180, 0x0180, 0x0180, 0x0180, 0x0180, 0x0180,
  0x0180, 0x0180, 0x0180, 0x0180, 0x0180, 0x0180, 0x0000, 0x0000,
  0x0180, 0x0180, 0x0000, 0x0000, 0x0000, 0x0000, 0x0000, 0x0000,
  /* 0x22: '"' */
  0x0000, 0x0000, 0x00CC, 0x00CC, 0x00CC, 0x00CC, 0x00CC, 0x00CC,
  0x0000, 0x0000, 0x0000, 0x0000, 0x0000, 0x0000, 0x0000, 0x0000,
  0x0000, 0x0000, 0x0000, 0x0000, 0x0000, 0x0000, 0x0000, 0x0000,
  /* 0x23: '#' */
  0x0000, 0x0000, 0x0000, 0x0000, 0x0000, 0x0000, 0x0C60, 0x0C60,
  0x0C60, 0x0630, 0x0630, 0x1FFE, 0x1FFE, 0x0630, 0x0738, 0x0318,
  0x1FFE, 0x1FFE, 0x0318, 0x0318, 0x018C, 0x018C, 0x018C, 0x0000,
  /* 0x24: '$' */
  0x0000, 0x0080, 0x03E0, 0x0FF8, 0x0E9C, 0x1C8C, 0x188C, 0x008C,
  0x0098, 0x01F8, 0x07E0, 0x0E80, 0x1C80, 0x188C, 0x188C, 0x189C,
  0x0CB8, 0x0FF0, 0x03E0, 0x0080, 0x0080, 0x0000, 0x0000, 0x0000,
  /* 0x25: '%' */
  0x0000, 0x0000, 0x0000, 0x180E, 0x0C1B, 0x0C11, 0x0611, 0x0611,
  0x0311, 0x0311, 0x019B, 0x018E, 0x38C0, 0x6CC0, 0x4460, 0x4460,
  0x4430, 0x4430, 0x4418, 0x6C18, 0x380C, 0x0000, 0x0000, 0x0000,
  /* 0x26: '&' */
  0x0000, 0x01E0, 0x03F0, 0x0738, 0x0618, 0x0618, 0x0330, 0x01F0,
  0x00F0, 0x00F8, 0x319C, 0x330E, 0x1E06, 0x1C06, 0x1C06, 0x3F06,
  0x73FC, 0x21F0, 0x0000, 0x0000, 0x0000, 0x0000, 0x0000, 0x0000,
  /* 0x27: ''' */
  0x0000, 0x0000, 0x000C, 0x000C, 0x000C, 0x000C, 0x000C, 0x000C,
  0x0000, 0x0000, 0x0000, 0x0000, 0x0000, 0x0000, 0x0000, 0x0000,
  0x0000, 0x0000, 0x0000, 0x0000, 0x0000, 0x0000, 0x0000, 0x0000,
  /* 0x28: '(' */
  0x0000, 0x0200, 0x0300, 0x0180, 0x00C0, 0x00C0, 0x0060, 0x0060,
  0x0030, 0x0030, 0x0030, 0x0030, 0x0030, 0x0030, 0x0030, 0x0030,
  0x0060, 0x0060, 0x00C0, 0x00C0, 0x0180, 0x0300, 0x0200, 0x0000,
  /* 0x29: ')' */
  0x0000, 0x0020, 0x0060, 0x00C0, 0x0180, 0x0180, 0x0300, 0x0300,
  0x0600, 0x0600, 0x0600, 0x0600, 0x0600, 0x0600, 0x0600, 0x0600,
  0x0300, 0x0300, 0x0180, 0x0180, 0x00C0, 0x0060, 0x0020, 0x0000,
  /* 0x2A: '*' */
  0x0000, 0x0000, 0x0000, 0x0000, 0x0000, 0x0000, 0x00C0, 0x00C0,
  0x06D8, 0x07F8, 0x01E0, 0x0330, 0x0738, 0x0000, 0x0000, 0x0000,
  0x0000, 0x0000, 0x0000, 0x0000, 0x0000, 0x0000, 0x0000, 0x0000,
  /* 0x2B: '+' */
  0x0000, 0x0000, 0x0000, 0x0000, 0x0000, 0x0000, 0x0180, 0x0180,
  0x0180, 0x0180, 0x0180, 0x3FFC, 0x3FFC, 0x0180, 0x0180, 0x0180,
  0x0180, 0x0180, 0x0000, 0x0000, 0x0000, 0x0000, 0x0000, 0x0000,
  /* 0x2C: ',' */
  0x0000, 0x0000, 0x0000, 0x0000, 0x0000, 0x0000, 0x0000, 0x0000,
  0x0000, 0x0000, 0x0000, 0x0000, 0x0000, 0x0000, 0x0000, 0x0000,
  0x0000, 0x0180, 0x0180, 0x0100, 0x0100, 0x0080, 0x0000, 0x0000,
  /* 0x2D: '-' */
  0x0000, 0x0000, 0x0000, 0x0000, 0x0000, 0x0000, 0x0000, 0x0000,
  0x0000, 0x0000, 0x0000, 0x0000, 0x07E0, 0x07E0, 0x0000, 0x0000,
  0x0000, 0x0000, 0x0000, 0x0000, 0x0000, 0x0000, 0x0000, 0x0000,
  /* 0x2E: '.' */
  0x0000, 0x0000, 0x0000, 0x0000, 0x0000, 0x0000, 0x0000, 0x0000,
  0x0000, 0x0000, 0x0000, 0x0000, 0x0000, 0x0000, 0x0000, 0x0000,
  0x0000, 0x00C0, 0x00C0, 0x0000, 0x0000, 0x0000, 0x0000, 0x0000,
  /* 0x2F: '/' */
  0x0000, 0x0C00, 0x0C00, 0x0600, 0x0600, 0x0600, 0x0300, 0x0300,
  0x0300, 0x0380, 0x0180, 0x0180, 0x0180, 0x00C0, 0x00C0, 0x00C0,
  0x0060, 0x0060, 0x0000, 0x0000, 0x0000, 0x0000, 0x0000, 0x0000,
  /* 0x30: '0' */
  0x0000, 0x03E0, 0x07F0, 0x0E38, 0x0C18, 0x180C, 0x180C, 0x180C,
  0x180C, 0x180C, 0x180C, 0x180C, 0x180C, 0x180C, 0x0C18, 0x0E38,
  0x07F0, 0x03E0, 0x0000, 0x0000, 0x0000, 0x0000, 0x0000, 0x0000,
  /* 0x31: '1' */
  0x0000, 0x0100, 0x0180, 0x01C0, 0x01F0, 0x0198, 0x0188, 0x0180,
  0x0180, 0x0180, 0x0180, 0x0180, 0x0180, 0x0180, 0x0180, 0x0180,
  0x0180, 0x0180, 0x0000, 0x0000, 0x0000, 0x0000, 0x0000, 0x0000,
  /* 0x32: '2' */
  0x0000, 0x03E0, 0x0FF8, 0x0C18, 0x180C, 0x180C, 0x1800, 0x1800,
  0x0C00, 0x0600, 0x0300, 0x0180, 0x00C0, 0x0060, 0x0030, 0x0018,
  0x1FFC, 0x1FFC, 0x0000, 0x0000, 0x0000, 0x0000, 0x0000, 0x0000,
  /* 0x33: '3' */
  0x0000, 0x01E0, 0x07F8, 0x0E18, 0x0C0C, 0x0C0C, 0x0C00, 0x0600,
  0x03C0, 0x07C0, 0x0C00, 0x1800, 0x1800, 0x180C, 0x180C, 0x0C18,
  0x07F8, 0x03E0, 0x0000, 0x0000, 0x0000, 0x0000, 0x0000, 0x0000,
  /* 0x34: '4' */
  0x0000, 0x0C00, 0x0E00, 0x0F00, 0x0F00, 0x0D80, 0x0CC0, 0x0C60,
  0x0C60, 0x0C30, 0x0C18, 0x0C0C, 0x3FFC, 0x3FFC, 0x0C00, 0x0C00,
  0x0C00, 0x0C00, 0x0000, 0x0000, 0x0000, 0x0000, 0x0000, 0x0000,
  /* 0x35: '5' */
  0x0000, 0x0FF8, 0x0FF8, 0x0018, 0x0018, 0x000C, 0x03EC, 0x07FC,
  0x0E1C, 0x1C00, 0x1800, 0x1800, 0x1800, 0x180C, 0x0C1C, 0x0E18,
  0x07F8, 0x03E0, 0x0000, 0x0000, 0x0000, 0x0000, 0x0000, 0x0000,
  /* 0x36: '6' */
  0x0000, 0x07C0, 0x0FF0, 0x1C38, 0x1818, 0x0018, 0x000C, 0x03CC,
  0x0FEC, 0x0E3C, 0x1C1C, 0x180C, 0x180C, 0x180C, 0x1C18, 0x0E38,
  0x07F0, 0x03E0, 0x0000, 0x0000, 0x0000, 0x0000, 0x0000, 0x0000,
  /* 0x37: '7' */
  0x0000, 0x1FFC, 0x1FFC, 0x0C00, 0x0600, 0x0600, 0x0300, 0x0380,
  0x0180, 0x01C0, 0x00C0, 0x00E0, 0x0060, 0x0060, 0x0070, 0x0030,
  0x0030, 0x0030, 0x0000, 0x0000, 0x0000, 0x0000, 0x0000, 0x0000,
  /* 0x38: '8' */
  0x0000, 0x03E0, 0x07F0, 0x0E38, 0x0C18, 0x0C18, 0x0C18, 0x0638,
  0x07F0, 0x07F0, 0x0C18, 0x180C, 0x180C, 0x180C, 0x180C, 0x0C38,
  0x0FF8, 0x03E0, 0x0000, 0x0000, 0x0000, 0x0000, 0x0000, 0x0000,
  /* 0x39: '9' */
  0x0000, 0x03E0, 0x07F0, 0x0E38, 0x0C1C, 0x180C, 0x180C, 0x180C,
  0x1C1C, 0x1E38, 0x1BF8, 0x19E0, 0x1800, 0x0C00, 0x0C00, 0x0E1C,
  0x07F8, 0x01F0, 0x0000, 0x0000, 0x0000, 0x0000, 0x0000, 0x0000,
  /* 0x3A: ':' */
  0x0000, 0x0000, 0x0000, 0x0000, 0x0000, 0x0000, 0x0180, 0x0180,
  0x0000, 0x0000, 0x0000, 0x0000, 0x0000, 0x0000, 0x0000, 0x0000,
  0x0180, 0x0180, 0x0000, 0x0000, 0x0000, 0x0000, 0x0000, 0x0000,
  /* 0x3B: ';' */
  0x0000, 0x0000, 0x0000, 0x0000, 0x0000, 0x0000, 0x0180, 0x0180,
  0x0000, 0x0000, 0x0000, 0x0000, 0x0000, 0x0000, 0x0000, 0x0000,
  0x0180, 0x0180, 0x0100, 0x0100, 0x0080, 0x0000, 0x0000, 0x0000,
  /* 0x3C: '<' */
  0x0000, 0x0000, 0x0000, 0x0000, 0x0000, 0x0000, 0x0000, 0x0000,
  0x1000, 0x1C00, 0x0F80, 0x03E0, 0x00F8, 0x0018, 0x00F8, 0x03E0,
  0x0F80, 0x1C00, 0x1000, 0x0000, 0x0000, 0x0000, 0x0000, 0x0000,
  /* 0x3D: '=' */
  0x0000, 0x0000, 0x0000, 0x0000, 0x0000, 0x0000, 0x0000, 0x0000,
  0x1FF8, 0x0000, 0x0000, 0x0000, 0x1FF8, 0x0000, 0x0000, 0x0000,
  0x0000, 0x0000, 0x0000, 0x0000, 0x0000, 0x0000, 0x0000, 0x0000,
  /* 0x3E: '>' */
  0x0000, 0x0000, 0x0000, 0x0000, 0x0000, 0x0000, 0x0000, 0x0000,
  0x0008, 0x0038, 0x01F0, 0x07C0, 0x1F00, 0x1800, 0x1F00, 0x07C0,
  0x01F0, 0x0038, 0x0008, 0x0000, 0x0000, 0x0000, 0x0000, 0x0000,
  /* 0x3F: '?' */
  0x0000, 0x03E0, 0x0FF8, 0x0C18, 0x180C, 0x180C, 0x1800, 0x0C00,
  0x0600, 0x0300, 0x0180, 0x00C0, 0x00C0, 0x00C0, 0x0000, 0x0000,
  0x00C0, 0x00C0, 0x0000, 0x0000, 0x0000, 0x0000, 0x0000, 0x0000,
  /* 0x40: '@' */
  0x0000, 0x0000, 0x07E0, 0x1818, 0x2004, 0x29C2, 0x4A22, 0x4411,
  0x4409, 0x4409, 0x4409, 0x2209, 0x1311, 0x0CE2, 0x4002, 0x2004,
  0x1818, 0x07E0, 0x0000, 0x0000, 0x0000, 0x0000, 0x0000, 0x0000,
  /* 0x41: 'A' */
  0x0000, 0x0380, 0x0380, 0x06C0, 0x06C0, 0x06C0, 0x0C60, 0x0C60,
  0x1830, 0x1830, 0x1830, 0x3FF8, 0x3FF8, 0x701C, 0x600C, 0x600C,
  0xC006, 0xC006, 0x0000, 0x0000, 0x0000, 0x0000, 0x0000, 0x0000,
  /* 0x42: 'B' */
  0x0000, 0x03FC, 0x0FFC, 0x0C0C, 0x180C, 0x180C, 0x180C, 0x0C0C,
  0x07FC, 0x0FFC, 0x180C, 0x300C, 0x300C, 0x300C, 0x300C, 0x180C,
  0x1FFC, 0x07FC, 0x0000, 0x0000, 0x0000, 0x0000, 0x0000, 0x0000,
  /* 0x43: 'C' */
  0x0000, 0x07C0, 0x1FF0, 0x3838, 0x301C, 0x700C, 0x6006, 0x0006,
  0x0006, 0x0006, 0x0006, 0x0006, 0x0006, 0x6006, 0x700C, 0x301C,
  0x1FF0, 0x07E0, 0x0000, 0x0000, 0x0000, 0x0000, 0x0000, 0x0000,
  /* 0x44: 'D' */
  0x0000, 0x03FE, 0x0FFE, 0x0E06, 0x1806, 0x1806, 0x3006, 0x3006,
  0x3006, 0x3006, 0x3006, 0x3006, 0x3006, 0x1806, 0x1806, 0x0E06,
  0x0FFE, 0x03FE, 0x0000, 0x0000, 0x0000, 0x0000, 0x0000, 0x0000,
  /* 0x45: 'E' */
  0x0000, 0x3FFC, 0x3FFC, 0x000C, 0x000C, 0x000C, 0x000C, 0x000C,
  0x1FFC, 0x1FFC, 0x000C, 0x000C, 0x000C, 0x000C, 0x000C, 0x000C,
  0x3FFC, 0x3FFC, 0x0000, 0x0000, 0x0000, 0x0000, 0x0000, 0x0000,
  /* 0x46: 'F' */
  0x0000, 0x3FF8, 0x3FF8, 0x0018, 0x0018, 0x0018, 0x0018, 0x0018,
  0x1FF8, 0x1FF8, 0x0018, 0x0018, 0x0018, 0x0018, 0x0018, 0x0018,
  0x0018, 0x0018, 0x0000, 0x0000, 0x0000, 0x0000, 0x0000, 0x0000,
  /* 0x47: 'G' */
  0x0000, 0x0FE0, 0x3FF8, 0x783C, 0x600E, 0xE006, 0xC007, 0x0003,
  0x0003, 0xFE03, 0xFE03, 0xC003, 0xC007, 0xC006, 0xC00E, 0xF03C,
  0x3FF8, 0x0FE0, 0x0000, 0x0000, 0x0000, 0x0000, 0x0000, 0x0000,
  /* 0x48: 'H' */
  0x0000, 0x300C, 0x300C, 0x300C, 0x300C, 0x300C, 0x300C, 0x300C,
  0x3FFC, 0x3FFC, 0x300C, 0x300C, 0x300C, 0x300C, 0x300C, 0x300C,
  0x300C, 0x300C, 0x0000, 0x0000, 0x0000, 0x0000, 0x0000, 0x0000,
  /* 0x49: 'I' */
  0x0000, 0x0180, 0x0180, 0x0180, 0x0180, 0x0180, 0x0180, 0x0180,
  0x0180, 0x0180, 0x0180, 0x0180, 0x0180, 0x0180, 0x0180, 0x0180,
  0x0180, 0x0180, 0x0000, 0x0000, 0x0000, 0x0000, 0x0000, 0x0000,
  /* 0x4A: 'J' */
  0x0000, 0x0600, 0x0600, 0x0600, 0x0600, 0x0600, 0x0600, 0x0600,
  0x0600, 0x0600, 0x0600, 0x0600, 0x0600, 0x0618, 0x0618, 0x0738,
  0x03F0, 0x01E0, 0x0000, 0x0000, 0x0000, 0x0000, 0x0000, 0x0000,
  /* 0x4B: 'K' */
  0x0000, 0x3006, 0x1806, 0x0C06, 0x0606, 0x0306, 0x0186, 0x00C6,
  0x0066, 0x0076, 0x00DE, 0x018E, 0x0306, 0x0606, 0x0C06, 0x1806,
  0x3006, 0x6006, 0x0000, 0x0000, 0x0000, 0x0000, 0x0000, 0x0000,
  /* 0x4C: 'L' */
  0x0000, 0x0018, 0x0018, 0x0018, 0x0018, 0x0018, 0x0018, 0x0018,
  0x0018, 0x0018, 0x0018, 0x0018, 0x0018, 0x0018, 0x0018, 0x0018,
  0x1FF8, 0x1FF8, 0x0000, 0x0000, 0x0000, 0x0000, 0x0000, 0x0000,
  /* 0x4D: 'M' */
  0x0000, 0xE00E, 0xF01E, 0xF01E, 0xF01E, 0xD836, 0xD836, 0xD836,
  0xD836, 0xCC66, 0xCC66, 0xCC66, 0xC6C6, 0xC6C6, 0xC6C6, 0xC6C6,
  0xC386, 0xC386, 0x0000, 0x0000, 0x0000, 0x0000, 0x0000, 0x0000,
  /* 0x4E: 'N' */
  0x0000, 0x300C, 0x301C, 0x303C, 0x303C, 0x306C, 0x306C, 0x30CC,
  0x30CC, 0x318C, 0x330C, 0x330C, 0x360C, 0x360C, 0x3C0C, 0x3C0C,
  0x380C, 0x300C, 0x0000, 0x0000, 0x0000, 0x0000, 0x0000, 0x0000,
  /* 0x4F: 'O' */
  0x0000, 0x07E0, 0x1FF8, 0x381C, 0x700E, 0x6006, 0xC003, 0xC003,
  0xC003, 0xC003, 0xC003, 0xC003, 0xC003, 0x6006, 0x700E, 0x381C,
  0x1FF8, 0x07E0, 0x0000, 0x0000, 0x0000, 0x0000, 0x0000, 0x0000,
  /* 0x50: 'P' */
  0x0000, 0x0FFC, 0x1FFC, 0x380C, 0x300C, 0x300C, 0x300C, 0x300C,
  0x180C, 0x1FFC, 0x07FC, 0x000C, 0x000C, 0x000C, 0x000C, 0x000C,
  0x000C, 0x000C, 0x0000, 0x0000, 0x0000, 0x0000, 0x0000, 0x0000,
  /* 0x51: 'Q' */
  0x0000, 0x07E0, 0x1FF8, 0x381C, 0x700E, 0x6006, 0xE003, 0xC003,
  0xC003, 0xC003, 0xC003, 0xC003, 0xE007, 0x6306, 0x3F0E, 0x3C1C,
  0x3FF8, 0xF7E0, 0xC000, 0x0000, 0x0000, 0x0000, 0x0000, 0x0000,
  /* 0x52: 'R' */
  0x0000, 0x0FFE, 0x1FFE, 0x3806, 0x3006, 0x3006, 0x3006, 0x3806,
  0x1FFE, 0x07FE, 0x0306, 0x0606, 0x0C06, 0x1806, 0x1806, 0x3006,
  0x3006, 0x6006, 0x0000, 0x0000, 0x0000, 0x0000, 0x0000, 0x0000,
  /* 0x53: 'S' */
  0x0000, 0x03E0, 0x0FF8, 0x0C1C, 0x180C, 0x180C, 0x000C, 0x001C,
  0x03F8, 0x0FE0, 0x1E00, 0x3800, 0x3006, 0x3006, 0x300E, 0x1C1C,
  0x0FF8, 0x07E0, 0x0000, 0x0000, 0x0000, 0x0000, 0x0000, 0x0000,
  /* 0x54: 'T' */
  0x0000, 0x7FFE, 0x7FFE, 0x0180, 0x0180, 0x0180, 0x0180, 0x0180,
  0x0180, 0x0180, 0x0180, 0x0180, 0x0180, 0x0180, 0x0180, 0x0180,
  0x0180, 0x0180, 0x0000, 0x0000, 0x0000, 0x0000, 0x0000, 0x0000,
  /* 0x55: 'U' */
  0x0000, 0x300C, 0x300C, 0x300C, 0x300C, 0x300C, 0x300C, 0x300C,
  0x300C, 0x300C, 0x300C, 0x300C, 0x300C, 0x300C, 0x300C, 0x1818,
  0x1FF8, 0x07E0, 0x0000, 0x0000, 0x0000, 0x0000, 0x0000, 0x0000,
  /* 0x56: 'V' */
  0x0000, 0x6003, 0x3006, 0x3006, 0x3006, 0x180C, 0x180C, 0x180C,
  0x0C18, 0x0C18, 0x0E38, 0x0630, 0x0630, 0x0770, 0x0360, 0x0360,
  0x01C0, 0x01C0, 0x0000, 0x0000, 0x0000, 0x0000, 0x0000, 0x0000,
  /* 0x57: 'W' */
  0x0000, 0x6003, 0x61C3, 0x61C3, 0x61C3, 0x3366, 0x3366, 0x3366,
  0x3366, 0x3366, 0x3366, 0x1B6C, 0x1B6C, 0x1B6C, 0x1A2C, 0x1E3C,
  0x0E38, 0x0E38, 0x0000, 0x0000, 0x0000, 0x0000, 0x0000, 0x0000,
  /* 0x58: 'X' */
  0x0000, 0xE00F, 0x700C, 0x3018, 0x1830, 0x0C70, 0x0E60, 0x07C0,
  0x0380, 0x0380, 0x03C0, 0x06E0, 0x0C70, 0x1C30, 0x1818, 0x300C,
  0x600E, 0xE007, 0x0000, 0x0000, 0x0000, 0x0000, 0x0000, 0x0000,
  /* 0x59: 'Y' */
  0x0000, 0xC003, 0x6006, 0x300C, 0x381C, 0x1838, 0x0C30, 0x0660,
  0x07E0, 0x03C0, 0x0180, 0x0180, 0x0180, 0x0180, 0x0180, 0x0180,
  0x0180, 0x0180, 0x0000, 0x0000, 0x0000, 0x0000, 0x0000, 0x0000,
  /* 0x5A: 'Z' */
  0x0000, 0x7FFC, 0x7FFC, 0x6000, 0x3000, 0x1800, 0x0C00, 0x0600,
  0x0300, 0x0180, 0x00C0, 0x0060, 0x0030, 0x0018, 0x000C, 0x0006,
  0x7FFE, 0x7FFE, 0x0000, 0x0000, 0x0000, 0x0000, 0x0000, 0x0000,
  /* 0x5B: '[' */
  0x0000, 0x03E0, 0x03E0, 0x0060, 0x0060, 0x0060, 0x0060, 0x0060,
  0x0060, 0x0060, 0x0060, 0x0060, 0x0060, 0x0060, 0x0060, 0x0060,
  0x0060, 0x0060, 0x0060, 0x0060, 0x0060, 0x03E0, 0x03E0, 0x0000,
  /* 0x5C: '\' */
  0x0000, 0x0030, 0x0030, 0x0060, 0x0060, 0x0060, 0x00C0, 0x00C0,
  0x00C0, 0x01C0, 0x0180, 0x0180, 0x0180, 0x0300, 0x0300, 0x0300,
  0x0600, 0x0600, 0x0000, 0x0000, 0x0000, 0x0000, 0x0000, 0x0000,
  /* 0x5D: ']' */
  0x0000, 0x03E0, 0x03E0, 0x0300, 0x0300, 0x0300, 0x0300, 0x0300,
  0x0300, 0x0300, 0x0300, 0x0300, 0x0300, 0x0300, 0x0300, 0x0300,
  0x0300, 0x0300, 0x0300, 0x0300, 0x0300, 0x03E0, 0x03E0, 0x0000,
  /* 0x5E: '^' */
  0x0000, 0x0000, 0x01C0, 0x01C0, 0x0360, 0x0360, 0x0360, 0x0630,
  0x0630, 0x0C18, 0x0C18, 0x0000, 0x0000, 0x0000, 0x0000, 0x0000,
  0x0000, 0x0000, 0x0000, 0x0000, 0x0000, 0x0000, 0x0000, 0x0000,
  /* 0x5F: '_' */
  0x0000, 0x0000, 0x0000, 0x0000, 0x0000, 0x0000, 0x0000, 0x0000,
  0x0000, 0x0000, 0x0000, 0x0000, 0x0000, 0x0000, 0x0000, 0x0000,
  0x0000, 0xFFFF, 0xFFFF, 0x0000, 0x0000, 0x0000, 0x0000, 0x0000,
  /* 0x60: ''' */
  0x0000, 0x000C, 0x000C, 0x000C, 0x000C, 0x000C, 0x000C, 0x0000,
  0x0000, 0x0000, 0x0000, 0x0000, 0x0000, 0x0000, 0x0000, 0x0000,
  0x0000, 0x0000, 0x0000, 0x0000, 0x0000, 0x0000, 0x0000, 0x0000,
  /* 0x61: 'a' */
  0x0000, 0x0000, 0x0000, 0x0000, 0x0000, 0x0000, 0x03F0, 0x07F8,
  0x0C1C, 0x0C0C, 0x0F00, 0x0FF0, 0x0CF8, 0x0C0C, 0x0C0C, 0x0F1C,
  0x0FF8, 0x18F0, 0x0000, 0x0000, 0x0000, 0x0000, 0x0000, 0x0000,
  /* 0x62: 'b' */
  0x0000, 0x0018, 0x0018, 0x0018, 0x0018, 0x0018, 0x03D8, 0x0FF8,
  0x0C38, 0x1818, 0x1818, 0x1818, 0x1818, 0x1818, 0x1818, 0x0C38,
  0x0FF8, 0x03D8, 0x0000, 0x0000, 0x0000, 0x0000, 0x0000, 0x0000,
  /* 0x63: 'c' */
  0x0000, 0x0000, 0x0000, 0x0000, 0x0000, 0x0000, 0x03C0, 0x07F0,
  0x0E30, 0x0C18, 0x0018, 0x0018, 0x0018, 0x0018, 0x0C18, 0x0E30,
  0x07F0, 0x03C0, 0x0000, 0x0000, 0x0000, 0x0000, 0x0000, 0x0000,
  /* 0x64: 'd' */
  0x0000, 0x1800, 0x1800, 0x1800, 0x1800, 0x1800, 0x1BC0, 0x1FF0,
  0x1C30, 0x1818, 0x1818, 0x1818, 0x1818, 0x1818, 0x1818, 0x1C30,
  0x1FF0, 0x1BC0, 0x0000, 0x0000, 0x0000, 0x0000, 0x0000, 0x0000,
  /* 0x65: 'e' */
  0x0000, 0x0000, 0x0000, 0x0000, 0x0000, 0x0000, 0x03C0, 0x0FF0,
  0x0C30, 0x1818, 0x1FF8, 0x1FF8, 0x0018, 0x0018, 0x1838, 0x1C30,
  0x0FF0, 0x07C0, 0x0000, 0x0000, 0x0000, 0x0000, 0x0000, 0x0000,
  /* 0x66: 'f' */
  0x0000, 0x0F80, 0x0FC0, 0x00C0, 0x00C0, 0x00C0, 0x07F0, 0x07F0,
  0x00C0, 0x00C0, 0x00C0, 0x00C0, 0x00C0, 0x00C0, 0x00C0, 0x00C0,
  0x00C0, 0x00C0, 0x0000, 0x0000, 0x0000, 0x0000, 0x0000, 0x0000,
  /* 0x67: 'g' */
  0x0000, 0x0000, 0x0000, 0x0000, 0x0000, 0x0000, 0x0DE0, 0x0FF8,
  0x0E18, 0x0C0C, 0x0C0C, 0x0C0C, 0x0C0C, 0x0C0C, 0x0C0C, 0x0E18,
  0x0FF8, 0x0DE0, 0x0C00, 0x0C0C, 0x061C, 0x07F8, 0x01F0, 0x0000,
  /* 0x68: 'h' */
  0x0000, 0x0018, 0x0018, 0x0018, 0x0018, 0x0018, 0x07D8, 0x0FF8,
  0x1C38, 0x1818, 0x1818, 0x1818, 0x1818, 0x1818, 0x1818, 0x1818,
  0x1818, 0x1818, 0x0000, 0x0000, 0x0000, 0x0000, 0x0000, 0x0000,
  /* 0x69: 'i' */
  0x0000, 0x00C0, 0x00C0, 0x0000, 0x0000, 0x0000, 0x00C0, 0x00C0,
  0x00C0, 0x00C0, 0x00C0, 0x00C0, 0x00C0, 0x00C0, 0x00C0, 0x00C0,
  0x00C0, 0x00C0, 0x0000, 0x0000, 0x0000, 0x0000, 0x0000, 0x0000,
  /* 0x6A: 'j' */
  0x0000, 0x00C0, 0x00C0, 0x0000, 0x0000, 0x0000, 0x00C0, 0x00C0,
  0x00C0, 0x00C0, 0x00C0, 0x00C0, 0x00C0, 0x00C0, 0x00C0, 0x00C0,
  0x00C0, 0x00C0, 0x00C0, 0x00C0, 0x00C0, 0x00F8, 0x0078, 0x0000,
  /* 0x6B: 'k' */
  0x0000, 0x000C, 0x000C, 0x000C, 0x000C, 0x000C, 0x0C0C, 0x060C,
  0x030C, 0x018C, 0x00CC, 0x006C, 0x00FC, 0x019C, 0x038C, 0x030C,
  0x060C, 0x0C0C, 0x0000, 0x0000, 0x0000, 0x0000, 0x0000, 0x0000,
  /* 0x6C: 'l' */
  0x0000, 0x00C0, 0x00C0, 0x00C0, 0x00C0, 0x00C0, 0x00C0, 0x00C0,
  0x00C0, 0x00C0, 0x00C0, 0x00C0, 0x00C0, 0x00C0, 0x00C0, 0x00C0,
  0x00C0, 0x00C0, 0x0000, 0x0000, 0x0000, 0x0000, 0x0000, 0x0000,
  /* 0x6D: 'm' */
  0x0000, 0x0000, 0x0000, 0x0000, 0x0000, 0x0000, 0x3C7C, 0x7EFF,
  0xE3C7, 0xC183, 0xC183, 0xC183, 0xC183, 0xC183, 0xC183, 0xC183,
  0xC183, 0xC183, 0x0000, 0x0000, 0x0000, 0x0000, 0x0000, 0x0000,
  /* 0x6E: 'n' */
  0x0000, 0x0000, 0x0000, 0x0000, 0x0000, 0x0000, 0x0798, 0x0FF8,
  0x1C38, 0x1818, 0x1818, 0x1818, 0x1818, 0x1818, 0x1818, 0x1818,
  0x1818, 0x1818, 0x0000, 0x0000, 0x0000, 0x0000, 0x0000, 0x0000,
  /* 0x6F: 'o' */
  0x0000, 0x0000, 0x0000, 0x0000, 0x0000, 0x0000, 0x03C0, 0x0FF0,
  0x0C30, 0x1818, 0x1818, 0x1818, 0x1818, 0x1818, 0x1818, 0x0C30,
  0x0FF0, 0x03C0, 0x0000, 0x0000, 0x0000, 0x0000, 0x0000, 0x0000,
  /* 0x70: 'p' */
  0x0000, 0x0000, 0x0000, 0x0000, 0x0000, 0x0000, 0x03D8, 0x0FF8,
  0x0C38, 0x1818, 0x1818, 0x1818, 0x1818, 0x1818, 0x1818, 0x0C38,
  0x0FF8, 0x03D8, 0x0018, 0x0018, 0x0018, 0x0018, 0x0018, 0x0000,
  /* 0x71: 'q' */
  0x0000, 0x0000, 0x0000, 0x0000, 0x0000, 0x0000, 0x1BC0, 0x1FF0,
  0x1C30, 0x1818, 0x1818, 0x1818, 0x1818, 0x1818, 0x1818, 0x1C30,
  0x1FF0, 0x1BC0, 0x1800, 0x1800, 0x1800, 0x1800, 0x1800, 0x0000,
  /* 0x72: 'r' */
  0x0000, 0x0000, 0x0000, 0x0000, 0x0000, 0x0000, 0x07B0, 0x03F0,
  0x0070, 0x0030, 0x0030, 0x0030, 0x0030, 0x0030, 0x0030, 0x0030,
  0x0030, 0x0030, 0x0000, 0x0000, 0x0000, 0x0000, 0x0000, 0x0000,
  /* 0x73: 's' */
  0x0000, 0x0000, 0x0000, 0x0000, 0x0000, 0x0000, 0x03E0, 0x03F0,
  0x0E38, 0x0C18, 0x0038, 0x03F0, 0x07C0, 0x0C00, 0x0C18, 0x0E38,
  0x07F0, 0x03E0, 0x0000, 0x0000, 0x0000, 0x0000, 0x0000, 0x0000,
  /* 0x74: 't' */
  0x0000, 0x0000, 0x0080, 0x00C0, 0x00C0, 0x00C0, 0x07F0, 0x07F0,
  0x00C0, 0x00C0, 0x00C0, 0x00C0, 0x00C0, 0x00C0, 0x00C0, 0x00C0,
  0x07C0, 0x0780, 0x0000, 0x0000, 0x0000, 0x0000, 0x0000, 0x0000,
  /* 0x75: 'u' */
  0x0000, 0x0000, 0x0000, 0x0000, 0x0000, 0x0000, 0x1818, 0x1818,
  0x1818, 0x1818, 0x1818, 0x1818, 0x1818, 0x1818, 0x1818, 0x1C38,
  0x1FF0, 0x19E0, 0x0000, 0x0000, 0x0000, 0x0000, 0x0000, 0x0000,
  /* 0x76: 'v' */
  0x0000, 0x0000, 0x0000, 0x0000, 0x0000, 0x0000, 0x180C, 0x0C18,
  0x0C18, 0x0C18, 0x0630, 0x0630, 0x0630, 0x0360, 0x0360, 0x0360,
  0x01C0, 0x01C0, 0x0000, 0x0000, 0x0000, 0x0000, 0x0000, 0x0000,
  /* 0x77: 'w' */
  0x0000, 0x0000, 0x0000, 0x0000, 0x0000, 0x0000, 0x41C1, 0x41C1,
  0x61C3, 0x6363, 0x6363, 0x6363, 0x3636, 0x3636, 0x3636, 0x1C1C,
  0x1C1C, 0x1C1C, 0x0000, 0x0000, 0x0000, 0x0000, 0x0000, 0x0000,
  /* 0x78: 'x' */
  0x0000, 0x0000, 0x0000, 0x0000, 0x0000, 0x0000, 0x381C, 0x1C38,
  0x0C30, 0x0660, 0x03C0, 0x03C0, 0x03C0, 0x03C0, 0x0660, 0x0C30,
  0x1C38, 0x381C, 0x0000, 0x0000, 0x0000, 0x0000, 0x0000, 0x0000,
  /* 0x79: 'y' */
  0x0000, 0x0000, 0x0000, 0x0000, 0x0000, 0x0000, 0x3018, 0x1830,
  0x1830, 0x1870, 0x0C60, 0x0C60, 0x0CE0, 0x06C0, 0x06C0, 0x0380,
  0x0380, 0x0380, 0x0180, 0x0180, 0x01C0, 0x00F0, 0x0070, 0x0000,
  /* 0x7A: 'z' */
  0x0000, 0x0000, 0x0000, 0x0000, 0x0000, 0x0000, 0x1FFC, 0x1FFC,
  0x0C00, 0x0600, 0x0300, 0x0180, 0x00C0, 0x0060, 0x0030, 0x0018,
  0x1FFC, 0x1FFC, 0x0000, 0x0000, 0x0000, 0x0000, 0x0000, 0x0000,
  /* 0x7B: '{' */
  0x0000, 0x0300, 0x0180, 0x00C0, 0x00C0, 0x00C0, 0x00C0, 0x00C0,
  0x00C0, 0x0060, 0x0060, 0x0030, 0x0060, 0x0040, 0x00C0, 0x00C0,
  0x00C0, 0x00C0, 0x00C0, 0x00C0, 0x0180, 0x0300, 0x0000, 0x0000,
  /* 0x7C: '|' */
  0x0000, 0x0180, 0x0180, 0x0180, 0x0180, 0x0180, 0x0180, 0x0180,
  0x0180, 0x0180, 0x0180, 0x0180, 0x0180, 0x0180, 0x0180, 0x0180,
  0x0180, 0x0180, 0x0180, 0x0180, 0x0180, 0x0180, 0x0180, 0x0000,
  /* 0x7D: '}' */
  0x0000, 0x0060, 0x00C0, 0x01C0, 0x0180, 0x0180, 0x0180, 0x0180,
  0x0180, 0x0300, 0x0300, 0x0600, 0x0300, 0x0100, 0x0180, 0x0180,
  0x0180, 0x0180, 0x0180, 0x0180, 0x00C0, 0x0060, 0x0000, 0x0000,
  /* 0x7E: '~' */
  0x0000, 0x0000, 0x0000, 0x0000, 0x0000, 0x0000, 0x0000, 0x0000,
  0x10F0, 0x1FF8, 0x0F08, 0x0000, 0x0000, 0x0000, 0x0000, 0x0000,
  0x0000, 0x0000, 0x0000, 0x0000, 0x0000, 0x0000, 0x0000, 0x0000,
  /* 0x7F: ' ' */
  0x0000, 0x0000, 0x0000, 0x0000, 0x0000, 0x0000, 0x0000, 0x0000,
  0x0000, 0x0000, 0x0000, 0x0000, 0x0000, 0x0000, 0x0000, 0x0000,
  0x0000, 0x0000, 0x0000, 0x0000, 0x0000, 0x0000, 0x0000, 0x0000,

  /* Special Symbols  starting at character 0x80 */
  /* 0x80: Circle - Empty */
  0x0000, 0x0000, 0x0000, 0x0000, 0x0000, 0x03C0, 0x0C30, 0x1008,
  0x2004, 0x2004, 0x4002, 0x4002, 0x4002, 0x4002, 0x4002, 0x2004,
  0x2004, 0x1008, 0x0C30, 0x03C0, 0x0000, 0x0000, 0x0000, 0x0000,
  /* 0x81: Circle - Full */
  0x0000, 0x0000, 0x0000, 0x0000, 0x0000, 0x03C0, 0x0FF0, 0x1FF8,
  0x3FFC, 0x3FFC, 0x7FFE, 0x7FFE, 0x7FFE, 0x7FFE, 0x7FFE, 0x3FFC,
  0x3FFC, 0x1FF8, 0x0FF0, 0x03C0, 0x0000, 0x0000, 0x0000, 0x0000,
  /* 0x82: Square - Empty */
  0x0000, 0x0000, 0x0000, 0x0000, 0x0000, 0x0000, 0x0000, 0x07E0,
  0x0FF0, 0x1818, 0x1818, 0x1818, 0x1818, 0x1818, 0x1818, 0x0FF0,
  0x07E0, 0x0000, 0x0000, 0x0000, 0x0000, 0x0000, 0x0000, 0x0000,
  /* 0x83: Square - Full */
  0x0000, 0x0000, 0x0000, 0x0000, 0x0000, 0x0000, 0x0000, 0x07E0,
  0x0FF0, 0x1FF8, 0x1FF8, 0x1FF8, 0x1FF8, 0x1FF8, 0x1FF8, 0x0FF0,
  0x07E0, 0x0000, 0x0000, 0x0000, 0x0000, 0x0000, 0x0000, 0x0000,
  /* 0x84: Up - Empty */
  0x0000, 0x0000, 0x0000, 0x0000, 0x0000, 0x0000, 0x0000, 0x0000,
  0x0000, 0x0000, 0x0000, 0x0000, 0x0180, 0x03C0, 0x0660, 0x0C30,
  0x1818, 0x1818, 0x1FF8, 0x1FF8, 0x0000, 0x0000, 0x0000, 0x0000,
  /* 0x85: Up - Full */
  0x0000, 0x0000, 0x0000, 0x0000, 0x0000, 0x0000, 0x0000, 0x0000,
  0x0000, 0x0000, 0x0000, 0x0000, 0x0180, 0x03C0, 0x07E0, 0x0FF0,
  0x1FF8, 0x1FF8, 0x1FF8, 0x1FF8, 0x0000, 0x0000, 0x0000, 0x0000,
  /* 0x86: Down - Empty */
  0x0000, 0x0000, 0x0000, 0x0000, 0x1FF8, 0x1FF8, 0x1818, 0x1818,
  0x0C30, 0x0660, 0x03C0, 0x0180, 0x0000, 0x0000, 0x0000, 0x0000,
  0x0000, 0x0000, 0x0000, 0x0000, 0x0000, 0x0000, 0x0000, 0x0000,
  /* 0x87: Down - Full */
  0x0000, 0x0000, 0x0000, 0x0000, 0x1FF8, 0x1FF8, 0x1FF8, 0x1FF8,
  0x0FF0, 0x07E0, 0x03C0, 0x0180, 0x0000, 0x0000, 0x0000, 0x0000,
  0x0000, 0x0000, 0x0000, 0x0000, 0x0000, 0x0000, 0x0000, 0x0000,
  /* 0x88: Left - Empty */
  0x0000, 0x0000, 0x0000, 0x0000, 0x0000, 0x0000, 0x0000, 0x01E0,
  0x01F0, 0x0198, 0x018C, 0x0186, 0x0186, 0x018C, 0x0198, 0x01F0,
  0x01E0, 0x0000, 0x0000, 0x0000, 0x0000, 0x0000, 0x0000, 0x0000,
  /* 0x89: Left - Full */
  0x0000, 0x0000, 0x0000, 0x0000, 0x0000, 0x0000, 0x0000, 0x01E0,
  0x01F0, 0x01F8, 0x01FC, 0x01FE, 0x01FE, 0x01FC, 0x01F8, 0x01F0,
  0x01E0, 0x0000, 0x0000, 0x0000, 0x0000, 0x0000, 0x0000, 0x0000,
  /* 0x8A: Right - Empty */
  0x0000, 0x0000, 0x0000, 0x0000, 0x0000, 0x0000, 0x0000, 0x0780,
  0x0F80, 0x1980, 0x3180, 0x6180, 0x6180, 0x3180, 0x1980, 0x0F80,
  0x0780, 0x0000, 0x0000, 0x0000, 0x0000, 0x0000, 0x0000, 0x0000,
  /* 0x8B: Right - Full */
  0x0000, 0x0000, 0x0000, 0x0000, 0x0000, 0x0000, 0x0000, 0x0780,
  0x0F80, 0x1F80, 0x3F80, 0x7F80, 0x7F80, 0x3F80, 0x1F80, 0x0F80,
  0x0780, 0x0000, 0x0000, 0x0000, 0x0000, 0x0000, 0x0000, 0x0000,
  /* 0x8C: Wait - Empty */
  0x0000, 0x01C0, 0x0220, 0x0220, 0x0140, 0x0630, 0x0808, 0x0808,
  0x0808, 0x0808, 0x0808, 0x0808, 0x0808, 0x0220, 0x0220, 0x0220,
  0x0220, 0x0220, 0x0220, 0x0220, 0x0220, 0x0220, 0x0220, 0x0000,
  /* 0x8D: Wait - Full */
  0x0000, 0x01C0, 0x03E0, 0x03E0, 0x01C0, 0x07F0, 0x0DD8, 0x0DD8,
  0x0DD8, 0x0DD8, 0x0DD8, 0x0DD8, 0x0DD8, 0x0360, 0x0360, 0x0360,
  0x0360, 0x0360, 0x0360, 0x0360, 0x0360, 0x0360, 0x0360, 0x0000,
  /* 0x8E: Walk - Empty */
  0x0000, 0x01C0, 0x0220, 0x0220, 0x0140, 0x0630, 0x0808, 0x0808,
  0x0808, 0x1004, 0x2002, 0x2002, 0x0140, 0x0220, 0x0220, 0x0410,
  0x0808, 0x0808, 0x1004, 0x1004, 0x2004, 0x4004, 0x0000, 0x0000,
  /* 0x8F: Walk - Full */
  0x0000, 0x01C0, 0x03E0, 0x03E0, 0x01C0, 0x07F0, 0x0DD8, 0x0DD8,
  0x0DD8, 0x19CC, 0x31C6, 0x61C2, 0x01C0, 0x0360, 0x0360, 0x0670,
  0x0C38, 0x0C18, 0x180C, 0x180C, 0x300C, 0x600C, 0x0000, 0x0000,
};

#if 1
const unsigned char hal_extbrd_keil_mcbqvga_fonts_06x08[] = {
  /* 0x20: Space ' ' */
  0x00, 0x00, 0x00, 0x00, 0x00, 0x00, 0x00, 0x00,
  /* 0x21: '!' */
  0x04, 0x04, 0x04, 0x04, 0x04, 0x00, 0x04, 0x00,
  /* 0x22: '"' */
  0x0A, 0x0A, 0x0A, 0x00, 0x00, 0x00, 0x00, 0x00,
  /* 0x23: '#' */
  0x0A, 0x0A, 0x1F, 0x0A, 0x1F, 0x0A, 0x0A, 0x00,
  /* 0x24: '$' */
  0x04, 0x1E, 0x05, 0x0E, 0x14, 0x0F, 0x04, 0x00,
  /* 0x25: '%' */
  0x03, 0x13, 0x08, 0x04, 0x02, 0x19, 0x18, 0x00,
  /* 0x26: '&' */
  0x02, 0x05, 0x05, 0x02, 0x15, 0x09, 0x16, 0x00,
  /* 0x27: ''' */
  0x0C, 0x0C, 0x04, 0x02, 0x00, 0x00, 0x00, 0x00,
  /* 0x28: '(' */
  0x08, 0x04, 0x02, 0x02, 0x02, 0x04, 0x08, 0x00,
  /* 0x29: ')' */
  0x02, 0x04, 0x08, 0x08, 0x08, 0x04, 0x02, 0x00,
  /* 0x2A: '*' */
  0x00, 0x04, 0x15, 0x0E, 0x0E, 0x15, 0x04, 0x00,
  /* 0x2B: '+' */
  0x00, 0x04, 0x04, 0x1F, 0x04, 0x04, 0x00, 0x00,
  /* 0x2C: ',' */
  0x00, 0x00, 0x00, 0x00, 0x0C, 0x0C, 0x04, 0x02,
  /* 0x2D: '-' */
  0x00, 0x00, 0x00, 0x1F, 0x00, 0x00, 0x00, 0x00,
  /* 0x2E: '.' */
  0x00, 0x00, 0x00, 0x00, 0x00, 0x0C, 0x0C, 0x00,
  /* 0x2F: '/' */
  0x00, 0x10, 0x08, 0x04, 0x02, 0x01, 0x00, 0x00,
  /* 0x30: '0' */
  0x0E, 0x11, 0x13, 0x15, 0x19, 0x11, 0x0E, 0x00,
  /* 0x31: '1' */
  0x04, 0x06, 0x04, 0x04, 0x04, 0x04, 0x0E, 0x00,
  /* 0x32: '2' */
  0x0E, 0x11, 0x10, 0x0E, 0x01, 0x01, 0x1F, 0x00,
  /* 0x33: '3' */
  0x1F, 0x10, 0x08, 0x0C, 0x10, 0x11, 0x0E, 0x00,
  /* 0x34: '4' */
  0x08, 0x0C, 0x0A, 0x09, 0x1F, 0x08, 0x08, 0x00,
  /* 0x35: '5' */
  0x1F, 0x01, 0x0F, 0x10, 0x10, 0x11, 0x0E, 0x00,
  /* 0x36: '6' */
  0x1C, 0x02, 0x01, 0x0F, 0x11, 0x11, 0x0E, 0x00,
  /* 0x37: '7' */
  0x1F, 0x10, 0x10, 0x08, 0x04, 0x02, 0x01, 0x00,
  /* 0x38: '8' */
  0x0E, 0x11, 0x11, 0x0E, 0x11, 0x11, 0x0E, 0x00,
  /* 0x39: '9' */
  0x0E, 0x11, 0x11, 0x1E, 0x10, 0x08, 0x07, 0x00,
  /* 0x3A: ':' */
  0x00, 0x00, 0x04, 0x00, 0x04, 0x00, 0x00, 0x00,
  /* 0x3B: ';' */
  0x00, 0x00, 0x04, 0x00, 0x04, 0x04, 0x02, 0x00,
  /* 0x3C: '<' */
  0x10, 0x08, 0x04, 0x02, 0x04, 0x08, 0x10, 0x00,
  /* 0x3D: '=' */
  0x00, 0x00, 0x1F, 0x00, 0x1F, 0x00, 0x00, 0x00,
  /* 0x3E: '>' */
  0x02, 0x04, 0x08, 0x10, 0x08, 0x04, 0x02, 0x00,
  /* 0x3F: '?' */
  0x0E, 0x11, 0x10, 0x0C, 0x04, 0x00, 0x04, 0x00,
  /* 0x40: '@' */
  0x0E, 0x11, 0x15, 0x1D, 0x0D, 0x01, 0x1E, 0x00,
  /* 0x41: 'A' */
  0x04, 0x0A, 0x11, 0x11, 0x1F, 0x11, 0x11, 0x00,
  /* 0x42: 'B' */
  0x0F, 0x11, 0x11, 0x0F, 0x11, 0x11, 0x0F, 0x00,
  /* 0x43: 'C' */
  0x0E, 0x11, 0x01, 0x01, 0x01, 0x11, 0x0E, 0x00,
  /* 0x44: 'D' */
  0x0F, 0x11, 0x11, 0x11, 0x11, 0x11, 0x0F, 0x00,
  /* 0x45: 'E' */
  0x1F, 0x01, 0x01, 0x0F, 0x01, 0x01, 0x1F, 0x00,
  /* 0x46: 'F' */
  0x1F, 0x01, 0x01, 0x0F, 0x01, 0x01, 0x01, 0x00,
  /* 0x47: 'G' */
  0x1E, 0x11, 0x01, 0x01, 0x19, 0x11, 0x1E, 0x00,
  /* 0x48: 'H' */
  0x11, 0x11, 0x11, 0x1F, 0x11, 0x11, 0x11, 0x00,
  /* 0x49: 'I' */
  0x0E, 0x04, 0x04, 0x04, 0x04, 0x04, 0x0E, 0x00,
  /* 0x4A: 'J' */
  0x1C, 0x08, 0x08, 0x08, 0x08, 0x09, 0x06, 0x00,
  /* 0x4B: 'K' */
  0x11, 0x09, 0x05, 0x03, 0x05, 0x09, 0x11, 0x00,
  /* 0x4C: 'L' */
  0x01, 0x01, 0x01, 0x01, 0x01, 0x01, 0x1F, 0x00,
  /* 0x4D: 'M' */
  0x11, 0x1B, 0x15, 0x15, 0x15, 0x11, 0x11, 0x00,
  /* 0x4E: 'N' */
  0x11, 0x11, 0x13, 0x15, 0x19, 0x11, 0x11, 0x00,
  /* 0x4F: 'O' */
  0x0E, 0x11, 0x11, 0x11, 0x11, 0x11, 0x0E, 0x00,
  /* 0x50: 'P' */
  0x0F, 0x11, 0x11, 0x0F, 0x01, 0x01, 0x01, 0x00,
  /* 0x51: 'Q' */
  0x0E, 0x11, 0x11, 0x11, 0x15, 0x09, 0x16, 0x00,
  /* 0x52: 'R' */
  0x0F, 0x11, 0x11, 0x0F, 0x05, 0x09, 0x11, 0x00,
  /* 0x53: 'S' */
  0x0E, 0x11, 0x01, 0x0E, 0x10, 0x11, 0x0E, 0x00,
  /* 0x54: 'T' */
  0x1F, 0x15, 0x04, 0x04, 0x04, 0x04, 0x04, 0x00,
  /* 0x55: 'U' */
  0x11, 0x11, 0x11, 0x11, 0x11, 0x11, 0x0E, 0x00,
  /* 0x56: 'V' */
  0x11, 0x11, 0x11, 0x11, 0x11, 0x0A, 0x04, 0x00,
  /* 0x57: 'W' */
  0x11, 0x11, 0x11, 0x15, 0x15, 0x15, 0x0A, 0x00,
  /* 0x58: 'X' */
  0x11, 0x11, 0x0A, 0x04, 0x0A, 0x11, 0x11, 0x00,
  /* 0x59: 'Y' */
  0x11, 0x11, 0x0A, 0x04, 0x04, 0x04, 0x04, 0x00,
  /* 0x5A: 'Z' */
  0x1F, 0x10, 0x08, 0x0E, 0x02, 0x01, 0x1F, 0x00,
  /* 0x5B: '[' */
  0x1E, 0x02, 0x02, 0x02, 0x02, 0x02, 0x1E, 0x00,
  /* 0x5C: '\' */
  0x00, 0x01, 0x02, 0x04, 0x08, 0x10, 0x00, 0x00,
  /* 0x5D: ']' */
  0x1E, 0x10, 0x10, 0x10, 0x10, 0x10, 0x1E, 0x00,
  /* 0x5E: '^' */
  0x04, 0x0A, 0x11, 0x00, 0x00, 0x00, 0x00, 0x00,
  /* 0x5F: '_' */
  0x00, 0x00, 0x00, 0x00, 0x00, 0x00, 0x1F, 0x00,
  /* 0x60: ''' */
  0x06, 0x06, 0x04, 0x08, 0x00, 0x00, 0x00, 0x00,
  /* 0x61: 'a' */
  0x00, 0x00, 0x06, 0x08, 0x0E, 0x09, 0x1E, 0x00,
  /* 0x62: 'b' */
  0x01, 0x01, 0x0D, 0x13, 0x11, 0x13, 0x0D, 0x00,
  /* 0x63: 'c' */
  0x00, 0x00, 0x0E, 0x11, 0x01, 0x11, 0x0E, 0x00,
  /* 0x64: 'd' */
  0x10, 0x10, 0x16, 0x19, 0x11, 0x19, 0x16, 0x00,
  /* 0x65: 'e' */
  0x00, 0x00, 0x0E, 0x11, 0x1F, 0x01, 0x0E, 0x00,
  /* 0x66: 'f' */
  0x08, 0x14, 0x04, 0x0E, 0x04, 0x04, 0x04, 0x00,
  /* 0x67: 'g' */
  0x00, 0x00, 0x0E, 0x19, 0x19, 0x16, 0x10, 0x0E,
  /* 0x68: 'h' */
  0x01, 0x01, 0x0D, 0x13, 0x11, 0x11, 0x11, 0x00,
  /* 0x69: 'i' */
  0x04, 0x00, 0x06, 0x04, 0x04, 0x04, 0x0E, 0x00,
  /* 0x6A: 'j' */
  0x08, 0x00, 0x08, 0x08, 0x08, 0x09, 0x06, 0x00,
  /* 0x6B: 'k' */
  0x01, 0x01, 0x09, 0x05, 0x03, 0x05, 0x09, 0x00,
  /* 0x6C: 'l' */
  0x06, 0x04, 0x04, 0x04, 0x04, 0x04, 0x0E, 0x00,
  /* 0x6D: 'm' */
  0x00, 0x00, 0x0B, 0x15, 0x15, 0x15, 0x15, 0x00,
  /* 0x6E: 'n' */
  0x00, 0x00, 0x0D, 0x13, 0x11, 0x11, 0x11, 0x00,
  /* 0x6F: 'o' */
  0x00, 0x00, 0x0E, 0x11, 0x11, 0x11, 0x0E, 0x00,
  /* 0x70: 'p' */
  0x00, 0x00, 0x0D, 0x13, 0x13, 0x0D, 0x01, 0x01,
  /* 0x71: 'q' */
  0x00, 0x00, 0x16, 0x19, 0x19, 0x16, 0x10, 0x10,
  /* 0x72: 'r' */
  0x00, 0x00, 0x0D, 0x13, 0x01, 0x01, 0x01, 0x00,
  /* 0x73: 's' */
  0x00, 0x00, 0x1E, 0x01, 0x0E, 0x10, 0x0F, 0x00,
  /* 0x74: 't' */
  0x04, 0x04, 0x1F, 0x04, 0x04, 0x14, 0x08, 0x00,
  /* 0x75: 'u' */
  0x00, 0x00, 0x11, 0x11, 0x11, 0x19, 0x16, 0x00,
  /* 0x76: 'v' */
  0x00, 0x00, 0x11, 0x11, 0x11, 0x0A, 0x04, 0x00,
  /* 0x77: 'w' */
  0x00, 0x00, 0x11, 0x11, 0x15, 0x15, 0x0A, 0x00,
  /* 0x78: 'x' */
  0x00, 0x00, 0x11, 0x0A, 0x04, 0x0A, 0x11, 0x00,
  /* 0x79: 'y' */
  0x00, 0x00, 0x11, 0x11, 0x1E, 0x10, 0x11, 0x0E,
  /* 0x7A: 'z' */
  0x00, 0x00, 0x1F, 0x08, 0x04, 0x02, 0x1F, 0x00,
  /* 0x7B: '{' */
  0x08, 0x04, 0x04, 0x02, 0x04, 0x04, 0x08, 0x00,
  /* 0x7C: '|' */
  0x04, 0x04, 0x04, 0x00, 0x04, 0x04, 0x04, 0x00,
  /* 0x7D: '}' */
  0x02, 0x04, 0x04, 0x08, 0x04, 0x04, 0x02, 0x00,
  /* 0x7E: '~' */
  0x02, 0x15, 0x08, 0x00, 0x00, 0x00, 0x00, 0x00,
  /* 0x7F: ' ' */
  0x00, 0x00, 0x00, 0x00, 0x00, 0x00, 0x00, 0x00,

  /* Special Symbols  starting at character 0x80 */
  /* 0x80: Circle - Empty */
  0x00, 0x00, 0x0C, 0x12, 0x12, 0x0C, 0x00, 0x00,
  /* 0x81: Circle - Full */
  0x00, 0x00, 0x0C, 0x1E, 0x1E, 0x0C, 0x00, 0x00,
  /* 0x82: Square - Empty */
  0x00, 0x00, 0x1E, 0x12, 0x12, 0x1E, 0x00, 0x00,
  /* 0x83: Square - Full */
  0x00, 0x00, 0x1E, 0x1E, 0x1E, 0x1E, 0x00, 0x00,
  /* 0x84: Up - Empty */
  0x00, 0x00, 0x0C, 0x0C, 0x12, 0x1E, 0x00, 0x00,
  /* 0x85: Up - Full */
  0x00, 0x00, 0x0C, 0x0C, 0x1E, 0x1E, 0x00, 0x00,
  /* 0x86: Down - Empty */
  0x00, 0x00, 0x1E, 0x12, 0x0C, 0x0C, 0x00, 0x00,
  /* 0x87: Down - Full */
  0x00, 0x00, 0x1E, 0x1E, 0x0C, 0x0C, 0x00, 0x00,
  /* 0x88: Left - Empty */
  0x00, 0x00, 0x18, 0x16, 0x16, 0x18, 0x00, 0x00,
  /* 0x89: Left - Full */
  0x00, 0x00, 0x18, 0x1E, 0x1E, 0x18, 0x00, 0x00,
  /* 0x8A: Right - Empty */
  0x00, 0x00, 0x06, 0x1A, 0x1A, 0x06, 0x00, 0x00,
  /* 0x8B: Right - Full */
  0x00, 0x00, 0x06, 0x1E, 0x1E, 0x06, 0x00, 0x00,
  /* 0x8C: Wait - Empty */
  0x00, 0x00, 0x0C, 0x12, 0x12, 0x0C, 0x00, 0x00,
  /* 0x8D: Wait - Full */
  0x00, 0x00, 0x0C, 0x1E, 0x1E, 0x0C, 0x00, 0x00,
  /* 0x8E: Walk - Empty */
  0x00, 0x00, 0x1E, 0x12, 0x12, 0x1E, 0x00, 0x00,
  /* 0x8F: Walk - Full */
  0x00, 0x00, 0x1E, 0x1E, 0x1E, 0x1E, 0x00, 0x00,
};
#endif

#endif//HAL_USE_EXTBRD_KEIL_MCBQVGA


// --------------------------------------------------------------------------------------------------------------------
// - end-of-file (leave a blank line after)
// --------------------------------------------------------------------------------------------------------------------



